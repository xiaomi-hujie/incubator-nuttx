## fs/littlefs/Kconfig
```kconfig
config FS_LITTLEFS
	bool "LITTLEFS File System"
	default n
	depends on !DISABLE_MOUNTPOINT
	---help---
		Build the LITTLEFS file system. https://github.com/ARMmbed/littlefs.

config FS_LITTLEFS_BLOCK_FACTOR
	int "LITTLEFS Block Factor"
	default 4
	depends on FS_LITTLEFS

config FS_LITTLEFS_BLOCK_CYCLE
	int "LITTLEFS Block Cycle"
	default 200
	depends on FS_LITTLEFS
```
